#include "lm4871.h"
#include "dac.h"   /* hdac, DAC_CHANNEL_1, DAC_ALIGN_12B_R */

/* ---- DWT microsecond delay -----------------------------------------------
 * The DAC is software-triggered (MX_DAC_Init: DAC_TRIGGER_NONE, no DMA), so a
 * beep is generated by toggling the DAC in a timed busy-wait. The Cortex-M3
 * DWT cycle counter gives the sub-millisecond timing HAL_Delay() cannot. This
 * is a blocking wait; under FreeRTOS a preemption merely stretches one half-
 * period, which for a beeper is inaudible. */
static void LM4871_DwtInit(void)
{
	CoreDebug->DEMCR |= CoreDebug_DEMCR_TRCENA_Msk;
	DWT->CYCCNT = 0u;
	DWT->CTRL   |= DWT_CTRL_CYCCNTENA_Msk;
}

static void LM4871_DelayUs(uint32_t us)
{
	uint32_t start = DWT->CYCCNT;
	uint32_t ticks = us * (SystemCoreClock / 1000000u);
	while ((DWT->CYCCNT - start) < ticks)
	{
		/* busy-wait */
	}
}

/* SD level that ACTIVATES the amplifier. LM4871 is active-low (SD low = on), so
 * with en_active_high == 0 the active level is GPIO_PIN_RESET. */
static GPIO_PinState LM4871_ActiveLevel(const LM4871_HandleTypeDef *h)
{
	return h->cfg.en_active_high ? GPIO_PIN_SET : GPIO_PIN_RESET;
}

static GPIO_PinState LM4871_IdleLevel(const LM4871_HandleTypeDef *h)
{
	return h->cfg.en_active_high ? GPIO_PIN_RESET : GPIO_PIN_SET;
}

static uint16_t LM4871_Clamp(uint16_t code)
{
	return (code > LM4871_DAC_MAX) ? (uint16_t)LM4871_DAC_MAX : code;
}

void LM4871_LoadDefaults(LM4871_Config *cfg)
{
	cfg->hdac        = &hdac;
	cfg->dac_channel = DAC_CHANNEL_1;          /* PA4 = DAC_OUT1 (net SPK-DAC) */
	cfg->dac_align   = DAC_ALIGN_12B_R;

	cfg->sd_port        = o_EN_SPK_GPIO_Port;  /* PA3 (net SPK-EN -> U15.1 SD) */
	cfg->sd_pin         = o_EN_SPK_Pin;
	cfg->en_active_high = 0u;                  /* SD is active-low (LM4871)    */

	cfg->dac_mid   = LM4871_DAC_MID;
	cfg->dac_amp   = LM4871_DEF_AMP;
	cfg->settle_ms = LM4871_SETTLE_MS;
}

void LM4871_Init(LM4871_HandleTypeDef *h, const LM4871_Config *cfg)
{
	h->cfg         = *cfg;
	h->enabled     = 0u;
	h->initialized = 1u;

	LM4871_DwtInit();

	/* Park the DAC at mid-scale before the amp comes up so there is no DC step
	 * pushed through Ci (turn-on click, datasheet Proper Selection of Ci). */
	HAL_DAC_Start(h->cfg.hdac, h->cfg.dac_channel);
	HAL_DAC_SetValue(h->cfg.hdac, h->cfg.dac_channel, h->cfg.dac_align,
	                 LM4871_Clamp(h->cfg.dac_mid));

	/* Boot muted: SD to the idle (shutdown) level -> micropower, no idle hiss. */
	LM4871_Disable(h);
}

void LM4871_Enable(LM4871_HandleTypeDef *h)
{
	HAL_GPIO_WritePin(h->cfg.sd_port, h->cfg.sd_pin, LM4871_ActiveLevel(h));
	h->enabled = 1u;
	if (h->cfg.settle_ms)
	{
		HAL_Delay(h->cfg.settle_ms);   /* let CB (1uF) ramp the outputs up */
	}
}

void LM4871_Disable(LM4871_HandleTypeDef *h)
{
	/* Return the DAC to mid before muting so the outputs settle at VDD/2 rather
	 * than being frozen mid-swing (reduces the turn-off click). */
	HAL_DAC_SetValue(h->cfg.hdac, h->cfg.dac_channel, h->cfg.dac_align,
	                 LM4871_Clamp(h->cfg.dac_mid));
	HAL_GPIO_WritePin(h->cfg.sd_port, h->cfg.sd_pin, LM4871_IdleLevel(h));
	h->enabled = 0u;
}

uint8_t LM4871_IsEnabled(const LM4871_HandleTypeDef *h)
{
	return h->enabled;
}

void LM4871_SetLevel(LM4871_HandleTypeDef *h, uint16_t code12)
{
	HAL_DAC_SetValue(h->cfg.hdac, h->cfg.dac_channel, h->cfg.dac_align,
	                 LM4871_Clamp(code12));
}

void LM4871_BeepEx(LM4871_HandleTypeDef *h, uint32_t freq_hz,
                   uint32_t duration_ms, uint16_t amplitude, uint8_t leave_enabled)
{
	uint8_t  was_enabled = h->enabled;
	uint16_t mid = LM4871_Clamp(h->cfg.dac_mid);
	uint16_t amp;
	uint16_t hi, lo;
	uint32_t half_us;
	uint32_t half_periods;
	uint32_t i;

	/* Clamp amplitude so both mid+amp and mid-amp stay inside [0, DAC_MAX]. */
	amp = amplitude;
	if (amp > mid)                    { amp = mid; }
	if (amp > (LM4871_DAC_MAX - mid)) { amp = (uint16_t)(LM4871_DAC_MAX - mid); }

	if (freq_hz == 0u || duration_ms == 0u || amp == 0u)
	{
		if (!leave_enabled && !was_enabled)
		{
			LM4871_Disable(h);
		}
		return;
	}

	hi = (uint16_t)(mid + amp);
	lo = (uint16_t)(mid - amp);

	/* Square wave: one full period is two half-periods (hi then lo). */
	half_us      = 1000000u / (2u * freq_hz);
	half_periods = ((uint32_t)duration_ms * 1000u) / half_us;

	if (!was_enabled)
	{
		LM4871_Enable(h);
	}

	for (i = 0u; i < half_periods; ++i)
	{
		uint16_t level = (i & 1u) ? lo : hi;
		HAL_DAC_SetValue(h->cfg.hdac, h->cfg.dac_channel, h->cfg.dac_align, level);
		LM4871_DelayUs(half_us);
	}

	/* Rest the DAC at mid-scale (silence) when done. */
	HAL_DAC_SetValue(h->cfg.hdac, h->cfg.dac_channel, h->cfg.dac_align, mid);

	if (!leave_enabled && !was_enabled)
	{
		LM4871_Disable(h);
	}
}

void LM4871_Beep(LM4871_HandleTypeDef *h, uint32_t freq_hz, uint32_t duration_ms)
{
	LM4871_BeepEx(h, freq_hz, duration_ms, h->cfg.dac_amp, 0u);
}

/* Board singleton: U15. */
LM4871_HandleTypeDef lm4871;

void LM4871_BoardInit(void)
{
	LM4871_Config cfg;

	LM4871_LoadDefaults(&cfg);
	LM4871_Init(&lm4871, &cfg);
}
